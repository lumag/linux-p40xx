## drivers/crypto/caam/Kconfig
```kconfig
config CRYPTO_DEV_FSL_CAAM
	tristate "Freescale CAAM-Multicore driver backend (EXPERIMENTAL)"
	depends on FSL_SOC
	help
	  Enables the driver module for Freescale's Cryptographic Accelerator
	  and Assurance Module (CAAM). This module adds support for scatterlist
	  crypto API, and also configures CAAM to operate as a DPAA component.

config CRYPTO_DEV_FSL_CAAM_RINGSIZE
	int "Job Queue ring size"
	depends on CRYPTO_DEV_FSL_CAAM
	range 2 10
	default "8"
	help
	  Select size of Job Queue rings as a power of 2, within the
	  range 2-10 (ring size 4-1024).
	  Examples:
		2 => 4
		3 => 8
		4 => 16
		5 => 32
		6 => 64
		7 => 128
		8 => 256
		9 => 512
		10 => 1024

config CRYPTO_DEV_FSL_CAAM_DC_LIB
	tristate "Freescale CAAM Descriptor Library (EXPERIMENTAL)"
	depends on CRYPTO_DEV_FSL_CAAM
	help
	  Enables the Descriptor Construction Library for use with
	  Freescale's Cryptographic Accelerator and Assurance Module (CAAM).

config CRYPTO_DEV_FSL_CAAM_CRYPTO_API
	tristate "Linux Kernel Scatterlist Crypto API support"
	depends on CRYPTO_DEV_FSL_CAAM_DC_LIB
	select CRYPTO_ALGAPI
	select CRYPTO_AUTHENC
	help
	  Selecting this will offload crypto for users of the
	  scatterlist crypto API (such as the linux native IPSec
	  stack NETKEY) to the SEC4 via a job queue.

config CRYPTO_DEV_FSL_CAAM_JQ_TEST
	tristate "Freescale CAAM-Multicore JobQ Test (EXPERIMENTAL)"
	depends on CRYPTO_DEV_FSL_CAAM
	depends on CRYPTO_DEV_FSL_CAAM_DC_LIB
	help
	  Enables a test module for to exercise CAAM through a
	  native job queue.
```

## drivers/hwqueue/Kconfig
```kconfig
menu "Hardware queue support"

menuconfig FSL_QMAN
	bool "Freescale Queue Manager (datapath) support"
	depends on PPC_E500MC
	default y
	---help---
	  If unsure, say Y.

if FSL_QMAN

config FSL_QMAN_CHECKING
	bool "additional driver checking"
	default y
	---help---
	  Compiles in additional checks to sanity-check the Qman driver and any
	  use of it by other code. Not recommended for performance.

config FSL_QMAN_PORTAL
	bool "Qman portal support"
	default y
	---help---
	  Compiles support to detect and support Qman software corenet portals
	  (as provided by the device-tree).

# The current driver is interrupt-driven only (poll-driven isn't yet supported).
config FSL_QMAN_HAVE_POLL
	bool
	default n

config FSL_QMAN_POLL_LIMIT
	int
	default 32

config FSL_QMAN_PORTAL_DISABLEAUTO
	bool "disable auto-initialisation of cpu-affine portals"
	depends on FSL_QMAN_PORTAL
	default n
	---help---
	  The high-level portal API, in its normal usage, requires that each cpu
	  have a portal assigned to it that is auto-initialised. If an
	  application is manually initialising portals in a non-cpu-affine
	  manner (or you are using the low-level portal API), this may need to
	  be disabled. If in doubt, say N.

config FSL_QMAN_PORTAL_DISABLEAUTO_DCA
	bool "disable discrete-consumption support on cpu-affine portals"
	depends on !FSL_QMAN_PORTAL_DISABLEAUTO
	default n
	---help---
	  By default, auto-initialised cpu-affine portals support
	  discrete-consumption acknowledgements, but this may be unimplemented
	  in the simulation model.

config FSL_QMAN_FQALLOCATOR
	bool "use Bman buffer pool 0 as a Qman FQ allocator"
	depends on FSL_QMAN_PORTAL && !FSL_BMAN_PORTAL_DISABLEAUTO
	default y
	---help---
	  If enabled, the Qman driver will assume that Bman buffer pool 0 has
	  been preseeded with frame queue IDs available for dynamic allocation.

config FSL_QMAN_FQRANGE
	bool "Implement a control-plane only allocator supporting ranges"
	default y
	---help---
	  This allocator does not use Bman or any other h/w resource, it
	  provides a s/w allocator implementation that supports allocating
	  and deallocating FQID ranges, with control over alignment.

config FSL_QMAN_CONFIG
	bool "Qman device management"
	default y
	---help---
	  If this linux image is running natively, you need this option. If this
	  linux image is running as a guest OS under the hypervisor, only one
	  guest OS ("the control plane") needs this option.

config FSL_QMAN_BUG_CGR_INIT
	bool "workaround early-silicon h/w bug"
	depends on FSL_QMAN_CONFIG && !FSL_QMAN_PORTAL_DISABLEAUTO
	default y
	---help---
	  Only an early revision of Qman h/w, s/w must explicitly initialise all
	  CGR memories to avoid a possible ECC error. This workaround will
	  perform the required initialisation on boot, and has no side-effects
	  thereafter. If in doubt, select Yes.

config FSL_QMAN_TEST
	tristate "Qman self-tests"
	depends on FSL_QMAN_PORTAL
	default n
	---help---
	  This option compiles self-test code for Qman.

config FSL_QMAN_TEST_STASH_POTATO
	bool "Qman 'hot potato' data-stashing self-test"
	depends on FSL_QMAN_TEST && FSL_QMAN_FQALLOCATOR && !FSL_QMAN_PORTAL_DISABLEAUTO
	default y
	---help---
	  This performs a "hot potato" style test enqueuing/dequeuing a frame
	  across a series of FQs scheduled to different portals (and cpus), with
	  DQRR, data and context stashing always on.

config FSL_QMAN_TEST_LOW
	bool "Qman low-level self-test"
	depends on FSL_QMAN_TEST && FSL_QMAN_PORTAL_DISABLEAUTO
	default y
	---help---
	  This takes an unused portal and portal and performs low-level
	  API testing with it.

config FSL_QMAN_TEST_LOW_BUG_INTERRUPTS
	bool "ignore interrupts and interrupt registers"
	depends on FSL_QMAN_TEST_LOW
	default n
	---help---
	  Certain versions of the cycle-accurate model don't support portal
	  interrupt lines or the associated registers.

config FSL_QMAN_TEST_LOW_BUG_STASHING
	bool "disable dequeue stashing (of DQRR and data/context)"
	depends on FSL_QMAN_TEST_LOW
	default n
	---help---
	  Support for DQRR stashing with the cycle-accurate model is still
	  experimental.

config FSL_QMAN_TEST_HIGH
	bool "Qman high-level self-test"
	depends on FSL_QMAN_TEST && !FSL_QMAN_PORTAL_DISABLEAUTO
	default y
	---help---
	  This requires the presence of cpu-affine portals, and performs
	  high-level API testing with them (whichever portal(s) are affine to
	  the cpu(s) the test executes on).

config FSL_QMAN_TEST_HIGH_BUG_VDQCR
	bool "don't test VDQCR"
	depends on FSL_QMAN_TEST_HIGH
	default n
	---help---
	  Certain (current) versions of the cycle-accurate model don't support
	  VDQCR.

# H/w settings that can be hard-coded for now.

# Corenet initiator settings. Stash request queues are 4-deep to match cores'
# ability to snart. Stash priority is 3, other priorities are 2.
config FSL_QMAN_CI_SCHED_CFG_SRCCIV
	int
	depends on FSL_QMAN_CONFIG
	default 4
config FSL_QMAN_CI_SCHED_CFG_SRQ_W
	int
	depends on FSL_QMAN_CONFIG
	default 3
config FSL_QMAN_CI_SCHED_CFG_RW_W
	int
	depends on FSL_QMAN_CONFIG
	default 2
config FSL_QMAN_CI_SCHED_CFG_BMAN_W
	int
	depends on FSL_QMAN_CONFIG
	default 2

# Workaround for rev1 h/w bug with respect to "fast-track", disable it.
config FSL_QMAN_BUG_FASTTRACK
	bool
	depends on FSL_QMAN_CONFIG
	default y

# Workaround for rev1 h/w bug with respect to class-scheduling weights.
config FSL_QMAN_BUG_CSW
	bool
	depends on FSL_QMAN_CONFIG
	default y

endif # FSL_QMAN

endmenu
```

## drivers/net/cardnet/Kconfig
```kconfig
#
# Boardnet configuration
#

menu "MPC85xx PCI agent mode driver"
	depends on NETDEVICES && PPC_85xx && !PCI

config CARDNET
	tristate "Cardnet driver support"
	---help---
	  cardnet driver is a simulating ethernet driver for and MPC85xxEMDS
	  board when it acts as PCI agent device.
	  If MPC85xxEMDS board acts as PCI agent and want to communicate with
	  the host through PCI interface, enable this cardnet driver and there
	  will be an ethernet device named cethx in the system. Corporating with
	  another ethernet device named bethx in the host system, the host and
	  agent can send package to each other.

endmenu

menu "MPC85xx board PCI demo driver"
	depends on NETDEVICES && PCI

config BOARDNET
	tristate "Boardnet driver support"
	---help---
	  Boardnet driver is a simulate ethernet driver for MPC85xxE PB
	  board when it acts as PCI agent device and plused into MPC85xxE PB board.
	  If MPC85xxE MDS board acts as PCI host and want to communicate
	  with MPC85xxE PB (agent) through PCI interface,enable this
	  boardnet driver and there will be an ethernet device named
	  bethx in the system.
	  Corporating with another ethernet device named cethx in the
	  agent system,the host and agent can send package to each other.

endmenu
```

## drivers/net/dpa/NetCommSw/Kconfig
```kconfig
menu "Frame Manager support"

menuconfig FSL_FMAN
	bool "Freescale Frame Manager (datapath) support"
	depends on PPC_E500MC
	default y
	---help---
	  If unsure, say Y.

if FSL_FMAN

config FSL_FMAN_TEST
	bool "FMan test module"
	default n
	---help---
	  This option compiles test code for FMan.

endif # FSL_FMAN

endmenu
```
